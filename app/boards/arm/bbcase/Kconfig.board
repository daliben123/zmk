## app/boards/arm/bbcase/Kconfig.board
```kconfig
# Copyright (c) 2023 ZitaoTech
# SPDX-License-Identifier: MIT

config BOARD_BBCASE
    bool "bbcase"
    depends on SOC_NRF52840_QIAA
```

## app/boards/arm/bbcase/Kconfig.defconfig
```kconfig
# Copyright (c) 2023 The ZMK Contributors
# SPDX-License-Identifier: Apache-2.0

if BOARD_BBCASE

config BOARD
	default "bbcase"

if USB_DEVICE_STACK

config USB_NRFX
    default y

endif # USB_DEVICE_STACK

config BT_CTLR
    default BT

endif # BOARD_BBCASE
```

## app/boards/arm/bbq10/Kconfig
```kconfig
# Copyright (c) 2025 XixiLee-boom
# SPDX-License-Identifier: MIT

config BOARD_ENABLE_DCDC
    bool "Enable DCDC mode"
    select SOC_DCDC_NRF52X
    default y
    depends on BOARD_BBQ10

config BOARD_ENABLE_DCDC_HV
    bool "High voltage DCDC converter"
    select SOC_DCDC_NRF52X_HV
    default y
    depends on BOARD_BBQ10
```

## app/boards/arm/bbq10/Kconfig.board
```kconfig
# Copyright (c) 2025 XixiLee-boom
# SPDX-License-Identifier: MIT

config BOARD_BBQ10
    bool "bbq10"
    depends on SOC_NRF52840_QIAA
```

## app/boards/arm/bbq20/bbq20_defconfig
```kconfig
# 硬件基础配置
CONFIG_SOC_SERIES_NRF52X=y
CONFIG_SOC_NRF52840_QIAA=y
CONFIG_BOARD_BBQ20=y
CONFIG_ARM_MPU=y
CONFIG_PINCTRL=y

# GPIO配置
CONFIG_GPIO=y

# 存储配置
CONFIG_USE_DT_CODE_PARTITION=y
CONFIG_BUILD_OUTPUT_UF2=y
CONFIG_MPU_ALLOW_FLASH_WRITE=y
CONFIG_NVS=y
CONFIG_SETTINGS_NVS=y
CONFIG_FLASH=y
CONFIG_FLASH_PAGE_LAYOUT=y
CONFIG_FLASH_MAP=y

# 电源与功耗管理 (根据原理图优化)
## 图示充电与电源路径管理需要这些配置
CONFIG_ZMK_EXT_POWER=y
CONFIG_ZMK_PM_SOFT_OFF=y
CONFIG_ZMK_USB_POWER=y  # USB电源检测
CONFIG_ZMK_SLEEP=n      # 禁用深度睡眠（图示电容可能需要持续供电）

# 传输功率设置 (匹配图中电容值)
CONFIG_BT_CTLR_TX_PWR_PLUS_8=y

# 空闲超时设置
CONFIG_ZMK_IDLE_TIMEOUT=30000

# 指示灯配置
CONFIG_ZMK_INDICATOR_LED=y
CONFIG_ZMK_INDICATOR_LAYER_BRT=100
CONFIG_ZMK_INDICATOR_LAYER_CYCLE_MAXBRT=100
CONFIG_ZMK_INDICATOR_LAYER_CYCLE_MINBRT=20
CONFIG_ZMK_INDICATOR_LAYER_CYCLE_INTERVAL=20
CONFIG_ZMK_INDICATOR_BRT_STEP=5
CONFIG_ZMK_INDICATOR_BLINK_INTERVAL=300

# 背光配置
CONFIG_ZMK_BACKLIGHT=y
CONFIG_ZMK_BACKLIGHT_BRT_START=40
CONFIG_ZMK_BACKLIGHT_BRT_STEP=10
CONFIG_ZMK_BACKLIGHT_ON_START=y
CONFIG_ZMK_BACKLIGHT_AUTO_OFF_IDLE=y

# HID指示灯
CONFIG_ZMK_HID_INDICATORS=y

# 触摸板配置
CONFIG_TRACKPAD_SCROLL_INTERVAL=20
CONFIG_TRACKPAD_SPEEDMULTIPLIER_HORIZONTAL=100
CONFIG_TRACKPAD_SPEEDMULTIPLIER_VERTICAL=100

# 鼠标支持
CONFIG_ZMK_MOUSE=y

# 去抖动设置
CONFIG_ZMK_KSCAN_DEBOUNCE_PRESS_MS=10
CONFIG_ZMK_KSCAN_DEBOUNCE_RELEASE_MS=10

# 连接选项
CONFIG_ZMK_USB=y
CONFIG_ZMK_BLE=y
CONFIG_BT_GATT_ENFORCE_SUBSCRIPTION=n  # 优化BLE连接

# 电池监控配置 (根据图中VCC调节器)
CONFIG_ZMK_BATTERY_REPORT_INTERVAL=600  # 10分钟报告一次
CONFIG_BT_BAS=n  # 禁用MACOS唤醒问题

# 设置保存
CONFIG_ZMK_SETTINGS_SAVE_DEBOUNCE=10000

# 日志配置
CONFIG_ZMK_USB_LOGGING=n

# ADC配置 (电池监控支持)
CONFIG_ADC=y
CONFIG_ADC_ASYNC=y

# 电容触摸选项 (如果应用)
# CONFIG_ZMK_KCAN_CAPACITIVE=y

# VCC电压监控 (优化3.3V/5.5V调节)
CONFIG_ZMK_VCC_MONITOR=y
CONFIG_ZMK_VCC_ALERT_THRESHOLD=3400  # 3.4V警告
```

## app/module/dts/bindings/sensor/avago,a320.yaml
```yaml
description: Avago A320 TouchPad Driver
compatible: "avago,a320"
include: i2c-device.yaml

properties:
  reset-gpios:
    type: phandle-array
    required: false
    description: Hardware reset pin (active low)
    # 删除 flags 项，改用 specifier-space 定义电平特性
    specifier-space: gpio  # 关键修复点

  motion-gpios:
    type: phandle-array
    required: false
    description: Motion detection interrupt pin (active high)
    specifier-space: gpio  # 关键修复点

  shutdown-gpios:
    type: phandle-array
    required: false
    description: Power shutdown control pin (active low)
    specifier-space: gpio  # 关键修复点
```
