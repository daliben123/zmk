## app/boards/arm/bb9900/Kconfig.board
```kconfig
# Copyright (c) 2025 daliben123
# SPDX-License-Identifier: MIT

config BOARD_BB9900
    bool "bb9900"
    depends on SOC_NRF52840_QIAA
```

## app/boards/arm/bbq20-e73/Kconfig.defconfig
```kconfig
# Copyright (c) 2026 daliben123
# SPDX-License-Identifier: MIT

if BOARD_BBQ20-E73

config ZMK_KEYBOARD_NAME
    default "bbq20-e73"

if USB_DEVICE_STACK

config USB_NRFX
    default y

endif # USB_DEVICE_STACK

if ZMK_BACKLIGHT

config PWM
    default y

config LED_PWM
    default y

endif # ZMK_BACKLIGHT

config BT_CTLR
    default BT

endif # BOARD_BBQ20-E73
```

## app/boards/arm/bbq20/Kconfig.board
```kconfig
# Copyright (c) 2025 daliben123
# SPDX-License-Identifier: MIT

config BOARD_BBQ20
    bool "bbq20"
    depends on SOC_NRF52840_QIAA
```
